## conf/layer.conf
```bitbake
# We have a conf and classes directory, append to BBPATH
BBPATH .= ":${LAYERDIR}"

# We have a recipes directory, add to BBFILES
BBFILES += "${LAYERDIR}/recipes-*/*/*.bb ${LAYERDIR}/recipes-*/*/*.bbappend"

BBFILE_COLLECTIONS += "heinervdm-layer"
BBFILE_PATTERN_heinervdm-layer := "^${LAYERDIR}/"
BBFILE_PRIORITY_heinervdm-layer = "7"
```
